#include <Arduino.h>
#include <IRremoteESP8266.h>
#include <IRsend.h>
#include <pgmspace.h>

// --- PINOUT ---
const uint16_t kIrLedPin = 7; // GPIO para o LED IR transmissor
const uint16_t kIrFreqKHz = 38;
const uint8_t kIrRepeatCount = 2;
const uint16_t kIrRepeatGapMs = 35;

// --- BOTÕES FÍSICOS ---
#define BTN_UP    3  // Aumentar temperatura
#define BTN_DOWN  4  // Diminuir temperatura
#define BTN_POWER 5  // Ligar / Desligar

// --- ESTADO DO AR ---
int currentTemp = 23;
bool acOn = false;
unsigned long lastDebounce[3] = {0, 0, 0};
const unsigned long DEBOUNCE_MS = 300;

IRsend irsend(kIrLedPin);

// --- IR RAW DATA (FROM CODIGOS_CAPTURADOS.md) ---
// Stored in PROGMEM (Flash memory) to save RAM
const uint16_t TEMP_30C[255] PROGMEM = {4444, 4334, 770, 442, 766, 444, 738, 1440, 768, 444, 764, 472, 738,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 562, 646};
const uint16_t TEMP_29C[255] PROGMEM = {4420, 4332, 796, 442, 766, 442, 740, 1442, 766, 468, 740, 470, 742,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 1664, 650};
const uint16_t TEMP_28C[255] PROGMEM = {4422, 4330, 796, 442, 740, 468, 742, 1438, 768, 468, 742, 442, 768,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 1636, 704};
const uint16_t TEMP_27C[255] PROGMEM = {4420, 4332, 796, 442, 742, 468, 742, 1440, 768, 468, 740, 468, 740,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 1666, 648};
const uint16_t TEMP_26C[255] PROGMEM = {4388, 4364, 738, 470, 712, 496, 716, 1492, 740, 470, 718, 464, 742,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 1700, 640};
const uint16_t TEMP_25C[255] PROGMEM = {4420, 4332, 770, 470, 740, 444, 762, 1416, 794, 444, 764, 444, 738,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 1668, 646};
const uint16_t TEMP_24C[255] PROGMEM = {4420, 4334, 770, 442, 766, 444, 766, 1442, 766, 444, 738, 470, 738,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 1642, 674};
const uint16_t TEMP_23C[255] PROGMEM = {4420, 4330, 796, 442, 742, 468, 742, 1440, 768, 470, 738, 442, 768,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 1638, 674};
const uint16_t TEMP_22C[255] PROGMEM = {4422, 4332, 770, 468, 740, 470, 740, 1468, 740, 468, 742, 442, 766,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 1664, 650};
const uint16_t TEMP_21C[255] PROGMEM = {4422, 4332, 794, 442, 768, 444, 738, 1440, 770, 468, 740, 468, 740,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 562, 648};
const uint16_t TEMP_20C[255] PROGMEM = {4422, 4332, 794, 442, 740, 470, 740, 1440, 768, 440, 770, 470, 738,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 536, 674};
const uint16_t TEMP_19C[255] PROGMEM = {4418, 4334, 768, 468, 738, 470, 740, 1442, 768, 444, 766, 442, 766,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 562, 648};
const uint16_t TEMP_18C[255] PROGMEM = {4420, 4332, 770, 468, 740, 442, 768, 1440, 766, 444, 766, 442, 742,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 534, 676};
const uint16_t TEMP_17C[255] PROGMEM = {4448, 4332, 770, 444, 766, 442, 740, 1468, 740, 470, 740, 468, 740,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 534, 676};
const uint16_t TEMP_16C[255] PROGMEM = {4422, 4330, 798, 442, 742, 442, 766, 1438, 770, 466, 744, 440, 768,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 534, 674};
const uint16_t POWER_OFF[255] PROGMEM = {4420, 4330, 770, 470, 738, 470, 740, 1442, 766, 442, 766, 442, 768,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 562, 674};

// --- WEB PAGE ---
const char* htmlPage = R"rawliteral(
<!DOCTYPE html>
<html>
<head>
  <meta charset="UTF-8">
  <meta name="viewport" content="width=device-width, initial-scale=1.0">
  <title>Controle AC - Morpheus</title>
  <style>
    * { box-sizing: border-box; margin: 0; padding: 0; }
    body {
      font-family: -apple-system, BlinkMacSystemFont, "Segoe UI", Roboto, sans-serif;
      background: #f0f2f5;
      display: flex;
      justify-content: center;
      align-items: center;
      min-height: 100vh;
      padding: 20px;
    }
    .container {
      width: 100%;
      max-width: 360px;
      background: white;
      border-radius: 24px;
      padding: 30px 25px;
      box-shadow: 0 10px 30px rgba(0,0,0,0.1);
    }
    h1 { text-align: center; color: #333; font-size: 20px; margin-bottom: 24px; }
    .temp-display {
      text-align: center;
      font-size: 80px;
      font-weight: 700;
      color: #007aff;
      line-height: 1;
      margin-bottom: 8px;
    }
    .state-label {
      text-align: center;
      font-size: 14px;
      font-weight: 600;
      letter-spacing: 1px;
      margin-bottom: 32px;
      color: #aaa;
    }
    .state-label.on { color: #34c759; }
    .btn-row {
      display: grid;
      grid-template-columns: 1fr 1fr 1fr;
      gap: 12px;
      margin-bottom: 20px;
    }
    .btn {
      padding: 18px 0;
      border: none;
      border-radius: 16px;
      font-size: 28px;
      font-weight: 700;
      cursor: pointer;
      transition: transform 0.1s, box-shadow 0.1s;
      box-shadow: 0 4px 10px rgba(0,0,0,0.08);
    }
    .btn:active { transform: scale(0.93); box-shadow: none; }
    .btn-down  { background: #e8f0ff; color: #007aff; }
    .btn-power { background: #ff3b30; color: white; font-size: 22px; }
    .btn-power.on { background: #34c759; }
    .btn-up    { background: #e8f0ff; color: #007aff; }
    .status {
      background: #f5f5f7;
      border-radius: 12px;
      padding: 12px;
      text-align: center;
      font-size: 13px;
      color: #666;
      min-height: 40px;
      display: flex;
      align-items: center;
      justify-content: center;
    }
  </style>
</head>
<body>
  <div class="container">
    <h1>❄️ Controle Ar</h1>
    <div class="temp-display" id="tempDisplay">23°C</div>
    <div class="state-label" id="stateLabel">DESLIGADO</div>
    <div class="btn-row">
      <button class="btn btn-down"  onclick="changeTemp(-1)">−</button>
      <button class="btn btn-power" id="btnPower" onclick="togglePower()">⏻</button>
      <button class="btn btn-up"    onclick="changeTemp(+1)">+</button>
    </div>
    <div class="status" id="status">Pronto.</div>
  </div>
  <script>
    let temp = 23;
    let acOn = false;
    const displayEl  = document.getElementById('tempDisplay');
    const statusEl   = document.getElementById('status');
    const stateLabel = document.getElementById('stateLabel');
    const btnPower   = document.getElementById('btnPower');

    function updateUI() {
      displayEl.textContent = temp + '°C';
      stateLabel.textContent = acOn ? 'LIGADO' : 'DESLIGADO';
      stateLabel.className = 'state-label' + (acOn ? ' on' : '');
      btnPower.className = 'btn btn-power' + (acOn ? ' on' : '');
    }

    function post(endpoint, value) {
      statusEl.textContent = 'Enviando...';
      fetch('/' + endpoint + '?value=' + value, {method: 'POST'})
        .then(r => r.ok ? r.text() : Promise.reject(r.status))
        .then(msg => statusEl.textContent = msg)
        .catch(e => statusEl.textContent = 'Erro: ' + e);
    }

    function changeTemp(delta) {
      const next = temp + delta;
      if (next < 16 || next > 30) return;
      temp = next;
      updateUI();
      if (acOn) post('temp', temp);
    }

    function togglePower() {
      acOn = !acOn;
      updateUI();
      if (acOn) post('power', 'on_temp_' + temp);
      else      post('power', 'off');
    }

    updateUI();
  </script>
</body>
</html>
)rawliteral";

// --- FUNCTION PROTOTYPES ---
void sendRawCode(const uint16_t* code, size_t len, const char* name);
void enviarTemperatura(int temp);

void setup() {
  Serial.begin(115200);
  irsend.begin();

  pinMode(BTN_UP,    INPUT_PULLUP);
  pinMode(BTN_DOWN,  INPUT_PULLUP);
  pinMode(BTN_POWER, INPUT_PULLUP);

  Serial.println("\nIniciando modo offline (somente botões físicos + IR)...");
  Serial.printf("IR no GPIO %d | Botões: UP=%d DOWN=%d POWER=%d\n", kIrLedPin, BTN_UP, BTN_DOWN, BTN_POWER);
}

void loop() {
  unsigned long now = millis();

  // Debug: mostra estado dos pinos a cada 2 segundos
  static unsigned long lastPrint = 0;
  if (now - lastPrint > 2000) {
    lastPrint = now;
    Serial.printf("[DEBUG] BTN_UP=%d BTN_DOWN=%d BTN_POWER=%d | acOn=%d temp=%d\n",
      digitalRead(BTN_UP), digitalRead(BTN_DOWN), digitalRead(BTN_POWER), acOn, currentTemp);
  }

  // BTN_POWER
  if (digitalRead(BTN_POWER) == LOW && (now - lastDebounce[2]) > DEBOUNCE_MS) {
    lastDebounce[2] = now;
    Serial.println("[BTN] POWER pressionado");
    if (acOn) {
      sendRawCode(POWER_OFF, 255, "DESLIGAR");
      acOn = false;
      Serial.println("Ar DESLIGADO");
    } else {
      enviarTemperatura(currentTemp);
      acOn = true;
      Serial.printf("Ar LIGADO em %d°C\n", currentTemp);
    }
  }

  // BTN_UP
  if (digitalRead(BTN_UP) == LOW && (now - lastDebounce[0]) > DEBOUNCE_MS) {
    lastDebounce[0] = now;
    Serial.println("[BTN] UP pressionado");
    if (currentTemp < 30) {
      currentTemp++;
      Serial.printf("Temp -> %d°C\n", currentTemp);
      if (acOn) enviarTemperatura(currentTemp);
    }
  }

  // BTN_DOWN
  if (digitalRead(BTN_DOWN) == LOW && (now - lastDebounce[1]) > DEBOUNCE_MS) {
    lastDebounce[1] = now;
    Serial.println("[BTN] DOWN pressionado");
    if (currentTemp > 16) {
      currentTemp--;
      Serial.printf("Temp -> %d°C\n", currentTemp);
      if (acOn) enviarTemperatura(currentTemp);
    }
  }
}

// --- IR SEND FUNCTIONS ---

void sendRawCode(const uint16_t* code_P, size_t len, const char* name) {
    if (code_P == nullptr) {
        Serial.printf("Código para '%s' é nulo.\n", name);
        return;
    }
    // Copy data from PROGMEM to a RAM buffer
    uint16_t ram_buffer[len];
    memcpy_P(ram_buffer, code_P, sizeof(uint16_t) * len);

    for (uint8_t i = 0; i < kIrRepeatCount; i++) {
      irsend.sendRaw(ram_buffer, len, kIrFreqKHz);
      if (i + 1 < kIrRepeatCount) {
        delay(kIrRepeatGapMs);
      }
    }

    Serial.printf("✅ Enviado comando '%s'\n", name);
}


void enviarTemperatura(int temp) {
  const uint16_t* code_ptr = nullptr;
  
  switch(temp) {
    case 30: code_ptr = TEMP_30C; break;
    case 29: code_ptr = TEMP_29C; break;
    case 28: code_ptr = TEMP_28C; break;
    case 27: code_ptr = TEMP_27C; break;
    case 26: code_ptr = TEMP_26C; break;
    case 25: code_ptr = TEMP_25C; break;
    case 24: code_ptr = TEMP_24C; break;
    case 23: code_ptr = TEMP_23C; break;
    case 22: code_ptr = TEMP_22C; break;
    case 21: code_ptr = TEMP_21C; break;
    case 20: code_ptr = TEMP_20C; break;
    case 19: code_ptr = TEMP_19C; break;
    case 18: code_ptr = TEMP_18C; break;
    case 17: code_ptr = TEMP_17C; break;
    case 16: code_ptr = TEMP_16C; break;
    default: 
      Serial.printf("❌ Temperatura inválida: %d°C\n", temp);
      return;
  }
  
  char temp_str[4];
  sprintf(temp_str, "%dC", temp);
  sendRawCode(code_ptr, 255, temp_str);
}